## config/boards/shields/duckfoot/Kconfig.defconfig
```kconfig
# Copyright (c) 2020 The ZMK Contributors
# SPDX-License-Identifier: MIT

if SHIELD_DUCKFOOT_LEFT

config ZMK_KEYBOARD_NAME
	default "DuckFootV2"

config ZMK_SPLIT_BLE_ROLE_CENTRAL
	default y

endif

if SHIELD_DUCKFOOT_LEFT || SHIELD_DUCKFOOT_RIGHT

config ZMK_SPLIT
	default y

endif
```
